# file: first_project.ioc
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FREERTOS.BinarySemaphores01=ButtonTasksSemaphore,Dynamic,NULL
FREERTOS.Tasks01=Task_K0,0,128,StartDefaultTask,Default,NULL,Dynamic,NULL,NULL;Task_K1,-3,128,StartTask02,Default,NULL,Dynamic,NULL,NULL
Mcu.Family=STM32F4
Mcu.Name=STM32F407V(E-G)Tx
Mcu.Package=LQFP100
NVIC.PriorityGroup=NVIC_PRIORITYGROUP_4
ProjectManager.HeapSize=0x200
ProjectManager.StackSize=0x400
ProjectManager.TargetToolchain=STM32CubeIDE
RCC.48MHZClocksFreq_Value=84000000
RCC.AHBFreq_Value=168000000
RCC.APB1CLKDivider=RCC_HCLK_DIV4
RCC.APB1Freq_Value=42000000
RCC.APB1TimFreq_Value=84000000
RCC.APB2CLKDivider=RCC_HCLK_DIV2
RCC.APB2Freq_Value=84000000
RCC.APB2TimFreq_Value=168000000
RCC.CortexFreq_Value=168000000
RCC.HCLKFreq_Value=168000000
RCC.HSE_VALUE=25000000
RCC.HSI_VALUE=16000000
RCC.LSE_VALUE=32768
RCC.PLLM=8
RCC.PLLN=168
RCC.SYSCLKFreq_VALUE=168000000
RCC.SYSCLKSource=RCC_SYSCLKSOURCE_PLLCLK
RCC.VCOOutputFreq_Value=336000000
VP_FREERTOS_VS_CMSIS_V1.Mode=CMSIS_V1
board=custom

// file: Core/Src/main.c
/* USER CODE BEGIN Header */
/**
  ******************************************************************************
  * @file           : main.c
  * @brief          : Main program body
  ******************************************************************************
  * @attention
  *
  * Copyright (c) 2023 STMicroelectronics.
  * All rights reserved.
  *
  * This software is licensed under terms that can be found in the LICENSE file
  * in the root directory of this software component.
  * If no LICENSE file comes with this software, it is provided AS-IS.
  *
  ******************************************************************************
  */
/* USER CODE END Header */
#include "main.h"
#include "cmsis_os.h"

osThreadId Task_K0Handle;
osThreadId Task_K1Handle;
osSemaphoreId ButtonTasksSemaphoreHandle;

void SystemClock_Config(void);
void StartTask_K0(void const * argument);
void StartTask_K1(void const * argument);

int main(void)
{

  /* MCU Configuration--------------------------------------------------------*/

  /* Reset of all peripherals, Initializes the Flash interface and the Systick. */
  HAL_Init();

  /* Configure the system clock */
  SystemClock_Config();

  /* USER CODE BEGIN SysInit */
  RCC->AHB1ENR |= RCC_AHB1ENR_GPIOAEN;//enabling A port clock
  RCC->AHB1ENR |= RCC_AHB1ENR_GPIOEEN;//enabling E port clock
  GPIOA->MODER |= GPIO_MODER_MODE6_0;
  GPIOA->MODER |= GPIO_MODER_MODE7_0;
  GPIOE->PUPDR |= GPIO_PUPDR_PUPD4_0 | GPIO_PUPDR_PUPD3_0;
  /* USER CODE END SysInit */

  /* Initialize all configured peripherals */
  /* USER CODE BEGIN 2 */
  //Sets LEDs to be turned of at the start
  GPIOA->BSRR |= GPIO_BSRR_BS7;
  GPIOA->BSRR |= GPIO_BSRR_BS6;
  /* USER CODE END 2 */

  /* Create the semaphores(s) */
  /* definition and creation of ButtonTasksSemaphore */
  osSemaphoreDef(ButtonTasksSemaphore);
  ButtonTasksSemaphoreHandle = osSemaphoreCreate(osSemaphore(ButtonTasksSemaphore), 1);

  /* Create the thread(s) */
  /* definition and creation of Task_K0 */
  osThreadDef(Task_K0, StartTask_K0, osPriorityNormal, 0, 128);
  Task_K0Handle = osThreadCreate(osThread(Task_K0), NULL);

  /* definition and creation of Task_K1 */
  osThreadDef(Task_K1, StartTask_K1, osPriorityNormal, 0, 128);
  Task_K1Handle = osThreadCreate(osThread(Task_K1), NULL);

  /* Start scheduler */
  osKernelStart();

  /* We should never get here as control is now taken by the scheduler */
  /* Infinite loop */
  while (1)
  {

  }
}

void SystemClock_Config(void)
{
  RCC_OscInitTypeDef RCC_OscInitStruct = {0};
  RCC_ClkInitTypeDef RCC_ClkInitStruct = {0};

  /** Configure the main internal regulator output voltage
  */
  __HAL_RCC_PWR_CLK_ENABLE();
  __HAL_PWR_VOLTAGESCALING_CONFIG(PWR_REGULATOR_VOLTAGE_SCALE1);

  /** Initializes the RCC Oscillators according to the specified parameters
  * in the RCC_OscInitTypeDef structure.
  */
  RCC_OscInitStruct.OscillatorType = RCC_OSCILLATORTYPE_HSI;
  RCC_OscInitStruct.HSIState = RCC_HSI_ON;
  RCC_OscInitStruct.HSICalibrationValue = RCC_HSICALIBRATION_DEFAULT;
  RCC_OscInitStruct.PLL.PLLState = RCC_PLL_ON;
  RCC_OscInitStruct.PLL.PLLSource = RCC_PLLSOURCE_HSI;
  RCC_OscInitStruct.PLL.PLLM = 8;
  RCC_OscInitStruct.PLL.PLLN = 168;
  RCC_OscInitStruct.PLL.PLLP = RCC_PLLP_DIV2;
  RCC_OscInitStruct.PLL.PLLQ = 4;
  if (HAL_RCC_OscConfig(&RCC_OscInitStruct) != HAL_OK)
  {
    Error_Handler();
  }

  /** Initializes the CPU, AHB and APB buses clocks
  */
  RCC_ClkInitStruct.ClockType = RCC_CLOCKTYPE_HCLK|RCC_CLOCKTYPE_SYSCLK
                              |RCC_CLOCKTYPE_PCLK1|RCC_CLOCKTYPE_PCLK2;
  RCC_ClkInitStruct.SYSCLKSource = RCC_SYSCLKSOURCE_PLLCLK;
  RCC_ClkInitStruct.AHBCLKDivider = RCC_SYSCLK_DIV1;
  RCC_ClkInitStruct.APB1CLKDivider = RCC_HCLK_DIV4;
  RCC_ClkInitStruct.APB2CLKDivider = RCC_HCLK_DIV2;

  if (HAL_RCC_ClockConfig(&RCC_ClkInitStruct, FLASH_LATENCY_5) != HAL_OK)
  {
    Error_Handler();
  }
}

void StartTask_K0(void const * argument)
{
  /* USER CODE BEGIN 5 */
	uint32_t tickstart;
	uint32_t wait = 3000;
  /* Infinite loop */
	 for(;;)
	  {
			  if ( (~(GPIOE->IDR) & GPIO_IDR_ID4) &&
					  !osSemaphoreWait(ButtonTasksSemaphoreHandle , osWaitForever))
			  {
				  //turning on the led
				  GPIOA->BSRR |= GPIO_BSRR_BR6;
				  osSemaphoreRelease(ButtonTasksSemaphoreHandle);
				  //turning on the led

				  //waiting
//				  tickstart = HAL_GetTick();
//				  while((HAL_GetTick() - tickstart) < wait) {}
				  osDelay(wait);
				  //waiting

				  //turning off the led
				  while(1){
					  if (!osSemaphoreWait(ButtonTasksSemaphoreHandle , osWaitForever)){
						  GPIOA->BSRR |= GPIO_BSRR_BS6;
						  osSemaphoreRelease(ButtonTasksSemaphoreHandle);
						  break;
					  }
				  }
				  //turning off the led
			  }

		  osDelay(10);
	  }
  /* USER CODE END 5 */
}

void StartTask_K1(void const * argument)
{
  /* USER CODE BEGIN StartTask02 */
  /* Infinite loop */
	uint32_t wait = 3000;

  for(;;)
  {
	  //Button K1
		  if ( (~(GPIOE->IDR) & GPIO_IDR_ID3) &&
				  !osSemaphoreWait(ButtonTasksSemaphoreHandle , osWaitForever))
		  {
			  GPIOA->BSRR |= GPIO_BSRR_BR7;
			  osSemaphoreRelease(ButtonTasksSemaphoreHandle);

			  osDelay(wait);

			  while(1) {
				  if (!osSemaphoreWait(ButtonTasksSemaphoreHandle , osWaitForever)){
					  GPIOA->BSRR |= GPIO_BSRR_BS7;
					  osSemaphoreRelease(ButtonTasksSemaphoreHandle);
					  break;
				  }
			  }

		  }
  }
  /* USER CODE END StartTask02 */
}

void Error_Handler(void)
{
  __disable_irq();
  while (1)
  {
  }
}
